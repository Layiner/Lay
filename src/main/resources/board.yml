## src/main/resources/board.yml
```yaml
board: |
  请管理员在服务器配置文件中修改当前的配置
  
  目录为"服务器目录\plugin\Lay\board.yml"
  ***
  三个*表示换页
  
  请使用UTF-8编码保存配置文件
  
  若服务器中显示乱码(特指中文)，请在启动配置文件末加上参数:
  
  -Dfile.encoding=UTF-8
  
  祝您愉快！
  ************************************************************************************
  恶搞[doge]

author: 作者
color: RED
#一共有如下颜色：
#DARK_RED  |RED  |GOLD         |YELLOW      |DARK_GREEN |GREEN |AQUA      |DARK_AQUA
#DARK_BLUE |BLUE |LIGHT_PURPLE |DARK_PURPLE |WHITE      |GRAY  |DARK_GRAY |BLACK
#请按照需求填写颜色，若填写错误则默认黑色
```
